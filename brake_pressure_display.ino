#include <Wire.h>
#include <Adafruit_GFX.h>
#include <Adafruit_SSD1306.h>


#define SCREEN_WIDTH 128
#define SCREEN_HEIGHT 64

Adafruit_SSD1306 display(SCREEN_WIDTH, SCREEN_HEIGHT, &Wire, -1);

static const uint8_t image_array_BajaLogo[1024] = {
  // 'Baja_Logo_SMALLLCD, 124x64px
	0x00, 0x00, 0x00, 0x00, 0x00, 0x00, 0x00, 0x00, 0x00, 0x00, 0x00, 0x00, 0x00, 0x00, 0x00, 0x00, 
	0x00, 0x00, 0x00, 0x00, 0x00, 0x00, 0x00, 0x00, 0x00, 0x00, 0x00, 0x00, 0x00, 0x00, 0x00, 0x00, 
	0x00, 0x00, 0x00, 0x00, 0x00, 0x00, 0x00, 0x00, 0x00, 0x00, 0x00, 0x00, 0x00, 0x00, 0x00, 0x00, 
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	0x00, 0x00, 0x00, 0x00, 0x00, 0x00, 0x00, 0x00, 0x00, 0x00, 0x00, 0x00, 0x00, 0x00, 0x00, 0x00
};

const int pressure_pin_front = 25; // analog input for sensor input, gpio0, adc11 
const int pressure_pin_rear = 13;
const int led_fr_pin = 15; // analog output for led front, gpio15, adc12 - works
const int led_re_pin = 2; // analog output for led rear, gpio2, adc13 - works
unsigned long gpioTimer = 0; // Timer for GPIO polling

void setup() {
  Serial.begin(115200);

  pinMode(pressure_pin_front, INPUT);
  pinMode(pressure_pin_rear, INPUT);
  pinMode(led_fr_pin, OUTPUT);
  pinMode(led_re_pin, OUTPUT);

  
  Wire.begin(5, 4);
  
  if(!display.begin(SSD1306_SWITCHCAPVCC, 0x3C)) {
    Serial.println(F("SSD1306 allocation failed"));
    for(;;);
  }

  analogReadResolution(12);

  delay(2000);
  display.clearDisplay();
  display.drawBitmap(0, 0, image_array_BajaLogo, 128, 64, 1);
  display.display();
  delay(3000);
  display.clearDisplay();
  display.setTextSize(2);
  display.setTextColor(WHITE);

  Serial.print("Setup Finished");

  digitalWrite(led_fr_pin, LOW);
  digitalWrite(led_re_pin, LOW);
}
 
 //2.2,5.59
void loop() {
  if (millis() - gpioTimer >= 500) {
    gpioTimer = millis();
    int adc_fr = analogRead(pressure_pin_front);
    int volt_fr = analogReadMilliVolts(pressure_pin_front);
    int adc_re = analogRead(pressure_pin_rear);
    int volt_re = analogReadMilliVolts(pressure_pin_rear);
    String status_fr = "";
    String status_re = "";

    display.setCursor(0, 10);
    //int brake_pres = (((1748) * ((adc_val * 3.3)/4096)) - (629.37)) ;
    // y=(1240.909*x)*1.3736264-625
    int pres_fr = (1.3736264 * 1240.909 * volt_fr/1000) - 625;
    int pres_re = (1.3736264 * 1240.909 * volt_re/1000) - 625;
    //Serial.println("FR:" + String(volt_fr) + " | " + String(pres_fr) + "\t\t\t" + " RE: " + String(volt_re) + " | " + String(pres_re));
    
    //Serial.println(String(adc_val) + " | " + String(((adc_val * 3.3)/4096)));
    if(pres_fr >= 2000){
      digitalWrite(led_fr_pin, HIGH);
    } else {
      digitalWrite(led_fr_pin, LOW);
    }
    
    if(pres_re >= 2000){
      digitalWrite(led_re_pin, HIGH);
    } else {
      digitalWrite(led_re_pin, LOW);
    }

    display.clearDisplay(); 
    display.setCursor(0, 10);
    if (pres_fr < 0){
      status_fr = "0";
    } else {
      status_fr = String(pres_fr);
    }

    if (pres_re < 0){
      status_re = "0";
    } else {
      status_re = String(pres_re);
    }
    display.print(" FR: " + String(status_fr) + "\n\n RE: " + String(status_re));
    
    display.display();
  }
}